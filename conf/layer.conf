## conf/layer.conf
```bitbake
# We have a conf and classes directory, add to BBPATH
BBPATH .= ":${LAYERDIR}"

# We have recipes-* directories, add to BBFILES
BBFILES += "${LAYERDIR}/recipes-*/*/*.bb \
	${LAYERDIR}/recipes-*/*/*.bbappend"

BBFILE_COLLECTIONS += "arm-board"
BBFILE_PATTERN_arm-board = "^${LAYERDIR}/"
BBFILE_PRIORITY_arm-board = "6"
FSL_EULA_FILE = "${LAYERDIR}/EULA"
IMX_MIRROR ?= "http://www.freescale.com/lgfiles/NMG/MAD/YOCTO/"
FSL_MIRROR ?= "${IMX_MIRROR}"
```

## conf/machine/nitrogen6x.conf
```bitbake
#@TYPE: Machine
#@NAME: Boundary Devices Nitrogen6X
#@SOC: i.MX6 Q/DL
#@DESCRIPTION: Machine configuration for Boundary Devices Nitrogen6X
#@MAINTAINER: Fabien Lahoudere <fabienlahoudere@collabora.co.uk>

DEFAULTTUNE_mx6 = "cortexa9thf-neon"
include conf/machine/include/tune-cortexa9.inc
MACHINEOVERRIDES =. "imx:mx6:mx6q:"

MACHINE_FEATURES = "usbgadget usbhost vfat alsa touchscreen "
#pci wifi bluetooth

SERIAL_CONSOLE = "115200 ttymxc1"

# Set specific make target and binary suffix
PREFERRED_PROVIDER_u-boot = "u-boot"
PREFERRED_PROVIDER_virtual/bootloader = "u-boot"
UBOOT_MAKE_TARGET ?= "u-boot.imx"
UBOOT_SUFFIX ?= "imx"
UBOOT_ENTRYPOINT = "0x10008000"
UBOOT_MACHINE = "nitrogen6q_defconfig"

PREFERRED_PROVIDER_virtual/kernel ?= "linux"
KERNEL_DEVICETREE = "imx6q-nitrogen6x.dtb"
KERNEL_IMAGETYPE = "uImage"
KERNEL_EXTRA_ARGS += "LOADADDR=${UBOOT_ENTRYPOINT}"

# Ship kernel modules
MACHINE_EXTRA_RRECOMMENDS = "kernel-modules"

PREFERRED_PROVIDER_virtual/mesa = "mesa"
PREFERRED_PROVIDER_virtual/egl = "mesa"
PREFERRED_PROVIDER_virtual/libgles1 = "mesa"
PREFERRED_PROVIDER_virtual/libgles2 = "mesa"
PREFERRED_PROVIDER_virtual/libgl = "mesa"
PREFERRED_PROVIDER_virtual/libopenvg = "mesa"

MACHINE_EXTRA_RRECOMMENDS += "linux-firmware-wl12xx linux-firmware-imx-sdma-imx6q linux-firmware-imx-sdma-imx7d firmware-imx-vpu-imx6q firmware-imx-vpu-imx6d"

MACHINE_ESSENTIAL_EXTRA_RDEPENDS += " \
    kernel-image \
    kernel-devicetree \
    u-boot \
"

WKS_FILES = "nitrogen.wks"

do_image_wic[depends] += " virtual/bootloader:do_build"

IMAGE_FSTYPES = "wic"
```

## conf/machine/riotboard.conf
```bitbake
#@TYPE: Machine
#@NAME: RIoTboard
#@SOC: i.MX6S
#@DESCRIPTION: Machine configuration for i.MX6S RIoTboard.
#@MAINTAINER: Fabien Lahoudere <fabienlahoudere@collabora.co.uk>

DEFAULTTUNE_mx6 = "cortexa9thf-neon"
include conf/machine/include/tune-cortexa9.inc
MACHINEOVERRIDES =. "imx:mx6:mx6dl:"

MACHINE_FEATURES = "usbgadget usbhost vfat alsa touchscreen"

SERIAL_CONSOLE = "115200 ttymxc1"

# Set specific make target and binary suffix
PREFERRED_PROVIDER_u-boot = "u-boot"
PREFERRED_PROVIDER_virtual/bootloader = "u-boot"
UBOOT_MAKE_TARGET ?= "u-boot.imx"
UBOOT_SUFFIX ?= "imx"
UBOOT_ENTRYPOINT = "0x10008000"
UBOOT_MACHINE = "riotboard_defconfig"

PREFERRED_PROVIDER_virtual/kernel ?= "linux"
KERNEL_DEVICETREE = "imx6dl-riotboard.dtb"
KERNEL_IMAGETYPE = "uImage"
KERNEL_EXTRA_ARGS += "LOADADDR=${UBOOT_ENTRYPOINT}"

# Ship kernel modules
MACHINE_EXTRA_RRECOMMENDS = "kernel-modules"

PREFERRED_PROVIDER_virtual/mesa = "mesa"
PREFERRED_PROVIDER_virtual/egl = "mesa"
PREFERRED_PROVIDER_virtual/libgles1 = "mesa"
PREFERRED_PROVIDER_virtual/libgles2 = "mesa"
PREFERRED_PROVIDER_virtual/libgl = "mesa"
PREFERRED_PROVIDER_virtual/libopenvg = "mesa"

MACHINE_EXTRA_RRECOMMENDS += "linux-firmware-imx-sdma-imx6q firmware-imx-vpu-imx6q firmware-imx-vpu-imx6d"

MACHINE_ESSENTIAL_EXTRA_RDEPENDS += " \
    kernel-image \
    kernel-devicetree \
    u-boot \
"

WKS_FILES = "riotboard.wks"

do_image_wic[depends] += " virtual/bootloader:do_build"

IMAGE_FSTYPES = "wic"
```
